## buildroot/package/simple-mtpfs/Config.in
```kconfig
config BR2_PACKAGE_SIMPLE_MTPFS
	bool "simple-mtpfs"
	select BR2_PACKAGE_LIBMTP
	help
	  Simple MTP fuse filesystem driver.

	  https://github.com/phatina/simple-mtpfs
```

## device/rockchip/.chips/rk182x/boot.its
```
/*
 * Copyright (C) 2025 Rockchip Electronics Co., Ltd
 *
 * SPDX-License-Identifier: GPL-2.0
 */

/dts-v1/;
/ {
    description = "Linux kernel and FDT blob";
    #address-cells = <1>;

    images {
        fdt {
	    description = "Flattened Device Tree blob";
            data = /incbin/("@KERNEL_DTB@");
            type = "flat_dt";
            arch = "riscv";
            compression = "none";
	    load = /bits/ 64 <0x540300000>;

            hash {
                algo = "sha256";
            };
        };

        kernel {
	    description = "RK1820 Linux kernel";
            data = /incbin/("@KERNEL_IMG@");
            type = "kernel";
            arch = "riscv";
            os = "linux";
            compression = "none";
	    load = /bits/ 64 <0x540400000>;
	    entry = /bits/ 64 <0x540400000>;

            hash {
                algo = "sha256";
            };
        };
    };

    configurations {
        default = "conf";

        conf {
	    description = "Boot Linux kernel with FDT blob";
            fdt = "fdt";
            kernel = "kernel";

        };
    };
};
```

## device/rockchip/.chips/rk3576/amp_mcu.its
```
/* SPDX-License-Identifier: BSD-3-Clause */
/*
 * Copyright (c) 2024 Rockchip Electronics Co., Ltd.
 */

/dts-v1/;
/ {
	description = "FIT source file for rockchip AMP";
	#address-cells = <1>;

	images {
		mcu {
			description  = "bus_mcu";       // bus_mcu or pmu_mcu
			data         = /incbin/("rtt.bin");
			type         = "standalone";
			compression  = "none";
			arch         = "arm";
			udelay       = <10000>;
			load         = <0x48000000>;
			sram_start   = <0x40000000>;    // {SYS_SGRF_SOC_CON17[31:10],10’h0}
			dev_start    = <0x20000000>;
			uc_start     = <0x20000000>;    // {SYS_SGRF_SOC_CON14[31:12],12’h0}
			uc_end       = <0x48000000>;    // {SYS_SGRF_SOC_CON15[31:12],12’h0}
			cpu          = <0>;
			compile {
				sys          = "rtt";    // "hal" or "rtt"
				rtt_config   = "board/evb/defconfig"
				core         = "mcu";    // "mcu" or "ap"
				rtt_exec     = "prebuilts/gcc/linux-x86/arm/gcc-arm-none-eabi-10-2020-q4-major-x86_64-linux/bin/"
				cc           = "prebuilts/gcc/linux-x86/arm/gcc-arm-none-eabi-10-2020-q4-major-x86_64-linux/bin/arm-none-eabi-"
			};

			hash {
				algo = "sha256";
			};
		};
	};

	share {
		rpmsg_base      = <0x47800000>;
		rpmsg_size      = <0x00400000>;
	};

	configurations {
		default = "conf";
		conf {
			description = "Rockchip AMP images";
			rollback-index = <0x0>;
			loadables = "mcu";

			signature {
				algo = "sha256,rsa2048";
				padding = "pss";
				key-name-hint = "dev";
				sign-images = "loadables";
			};

			/* - run linux on cpu0
			 * - it is brought up by amp(that run on U-Boot)
			 * - it is boot entry depends on U-Boot
			 */
			linux {
				description  = "linux-os";
				arch         = "arm64";
				cpu          = <0x000>;
				thumb        = <0>;
				hyp          = <0>;
				udelay       = <0>;
				load         = <0x42100000>;
				load_c       = <0x45480000>;
			};
		};
	};
};
```
