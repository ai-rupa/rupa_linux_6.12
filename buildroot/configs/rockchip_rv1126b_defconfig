## buildroot/configs/rockchip_rv1126b_defconfig
```kconfig
#include "base/base.config"
#include "wifibt/bt.config"
#include "wifibt/wireless.config"
#include "chips/rv1126b_aarch64.config"
#include "font/chinese.config"
#include "fs/exfat.config"
#include "fs/ntfs.config"
#include "fs/vfat.config"
#include "multimedia/audio.config"
#include "multimedia/camera.config"
#include "multimedia/gst/audio.config"
#include "multimedia/gst/camera.config"
#include "multimedia/gst/rtsp.config"
#include "multimedia/gst/video.config"
#include "multimedia/mpp.config"
#include "ai/npu2.config"
#include "ai/rknn-llm.config"
#include "tools/benchmark.config"
#include "tools/common.config"
#include "tools/test.config"
#include "gpu/mesa3d.config"
#include "gui/weston.config"
# BR2_PACKAGE_GST1_PLUGINS_GOOD_PLUGIN_PULSE is reset to default
BR2_PACKAGE_LIBSNDFILE=y
BR2_PACKAGE_LIBTOOL=y
# BR2_PACKAGE_PULSEAUDIO is reset to default
```

## buildroot/configs/rockchip_rv1126b_dv_defconfig
```kconfig
#include "rockchip_rv1126b_ipc_defconfig"
#include "gui/lvgl/v8/lvgl_dv.config"
BR2_GCC_ENABLE_OPENMP=y
# BR2_PACKAGE_IPCWEB_BACKEND is reset to default
# BR2_PACKAGE_IPCWEB_BACKEND_USE_RKIPC is reset to default
BR2_PACKAGE_LIBPNG=y
BR2_PACKAGE_LV_DRIVERS=y
BR2_PACKAGE_RKIPC_RV1126B_DV=y
# BR2_PACKAGE_RKIPC_RV1126B is reset to default
```

## buildroot/configs/rockchip_rv1126b_fastboot_defconfig
```kconfig
#include "base/tiny.config"
#include "chips/rv1126b_aarch64.config"
BR2_PACKAGE_CAMERA_ENGINE_RKAIQ_FASTBOOT_CUT=y
BR2_PACKAGE_CAMERA_ENGINE_RKAIQ_SPECIFIC_IQFILE="isp35/common/sc450ai_default_default.json isp35/common/sc850sl_default_default.json"
BR2_PACKAGE_COMMON_ALGORITHM_FASTBOOT_CUT=y
BR2_PACKAGE_IVA_RV1126B=y
BR2_PACKAGE_RKIPC=y
BR2_PACKAGE_RKIPC_FASTBOOT_CUT=y
BR2_PACKAGE_RKIPC_RV1126B=y
BR2_ROOTFS_OVERLAY="board/rockchip/rv1126b/fs-overlay-fastboot/"
BR2_ROOTFS_POST_BUILD_SCRIPT="board/rockchip/common/post-build.sh board/rockchip/common/tinyrootfs/post-build-tinyrootfs.sh board/rockchip/common/tinyrootfs/post-build-fastboot.sh"
BR2_TARGET_ROOTFS_EROFS=y
BR2_TARGET_ROOTFS_EROFS_GZIP=y
```

## buildroot/configs/rockchip_rv1126b_pcba_defconfig
```kconfig
#include "base/pcba.config"
#include "chips/rv1126b_aarch64.config"
#include "fs/vfat.config"
#include "multimedia/audio.config"
#include "multimedia/camera.config"
#include "multimedia/gst/audio.config"
#include "multimedia/gst/camera.config"
#include "multimedia/gst/video.config"
#include "multimedia/mpp.config"
#include "wifibt/bt.config"
#include "wifibt/wireless.config"

BR2_TARGET_GENERIC_HOSTNAME="rv1126b_pcba"
```

## buildroot/configs/rockchip_systemd_defconfig
```kconfig
#include "base/base.config"
#include "chips/rk3588_aarch64.config"
#include "gpu/mali.config"
#include "gui/weston.config"
BR2_INIT_SYSTEMD=y
```

## buildroot/configs/rockchip_tools_arm32_defconfig
```kconfig
#include "base/base.config"
BR2_arm=y
BR2_cortex_a7=y
BR2_PACKAGE_ANDROID_ADB=y
BR2_PACKAGE_ANDROID_ADBD=y
BR2_PACKAGE_ANDROID_ADBD_STATIC=y
BR2_PACKAGE_ANDROID_ADB_STATIC=y
BR2_PACKAGE_AUDIT=y
BR2_PACKAGE_AUDIT_STATIC=y
BR2_PACKAGE_BUSYBOX_CONFIG="package/busybox/busybox-full.config"
BR2_PACKAGE_BUSYBOX_STATIC=y
BR2_PACKAGE_COREMARK=y
BR2_PACKAGE_COREMARK_STATIC=y
BR2_PACKAGE_DHRYSTONE=y
BR2_PACKAGE_DHRYSTONE_STATIC=y
BR2_PACKAGE_EDID_DECODE=y
BR2_PACKAGE_EDID_DECODE_STATIC=y
BR2_PACKAGE_FRECON=y
BR2_PACKAGE_FRECON_SCALE=1
BR2_PACKAGE_FRECON_STATIC=y
BR2_PACKAGE_GDB=y
BR2_PACKAGE_GDB_DEBUGGER=y
BR2_PACKAGE_GDB_SERVER=y
BR2_PACKAGE_GDB_STATIC=y
BR2_PACKAGE_GPTFDISK=y
BR2_PACKAGE_GPTFDISK_CGDISK=y
BR2_PACKAGE_GPTFDISK_GDISK=y
BR2_PACKAGE_GPTFDISK_SGDISK=y
BR2_PACKAGE_GPTFDISK_STATIC=y
BR2_PACKAGE_INOTIFY_TOOLS=y
BR2_PACKAGE_INOTIFY_TOOLS_STATIC=y
BR2_PACKAGE_INPUT_EVENT_DAEMON=y
BR2_PACKAGE_INPUT_EVENT_DAEMON_STATIC=y
BR2_PACKAGE_IRQBALANCE=y
BR2_PACKAGE_IRQBALANCE_STATIC=y
BR2_PACKAGE_JPEG=y
BR2_PACKAGE_JPEG_TURBO_STATIC=y
BR2_PACKAGE_LIBCURL_TLS_NONE=y
BR2_PACKAGE_LIBDRM_INSTALL_TESTS=y
BR2_PACKAGE_LIBGLIB2_STATIC=y
BR2_PACKAGE_LIBTELNET=y
BR2_PACKAGE_LIBTELNET_STATIC=y
BR2_PACKAGE_LIBTIRPC=y
BR2_PACKAGE_LIBUNWIND=y
BR2_PACKAGE_LIBUNWIND_STATIC=y
BR2_PACKAGE_LINUX_TOOLS_PERF=y
BR2_PACKAGE_LINUX_TOOLS_PERF_STATIC=y
BR2_PACKAGE_LTRACE=y
BR2_PACKAGE_LTRACE_STATIC=y
BR2_PACKAGE_MEMTESTER=y
BR2_PACKAGE_MEMTESTER_STATIC=y
BR2_PACKAGE_NCURSES_STATIC=y
BR2_PACKAGE_PROCPS_NG=y
BR2_PACKAGE_PROCPS_NG_STATIC=y
BR2_PACKAGE_PROCRANK_LINUX=y
BR2_PACKAGE_PROCRANK_LINUX_STATIC=y
BR2_PACKAGE_RECOVERY=y
BR2_PACKAGE_RECOVERY_STATIC=y
BR2_PACKAGE_RECOVERY_UPDATEENGINEBIN=y
BR2_PACKAGE_RKTOOLKIT_STATIC=y
BR2_PACKAGE_RKUPDATE=y
BR2_PACKAGE_RKUPDATE_STATIC=y
BR2_PACKAGE_RKWIFIBT=y
BR2_PACKAGE_RKWIFIBT_STATIC=y
BR2_PACKAGE_STRACE=y
BR2_PACKAGE_STRACE_STATIC=y
BR2_PACKAGE_STRESSAPPTEST=y
BR2_PACKAGE_STRESSAPPTEST_STATIC=y
BR2_PACKAGE_UMTPRD=y
BR2_PACKAGE_UMTPRD_STATIC=y
BR2_PACKAGE_UVC_GADGET=y
BR2_PACKAGE_UVC_GADGET_STATIC=y
BR2_PACKAGE_XZ=y
BR2_PACKAGE_ZSTD=y
BR2_PACKAGE_ZSTD_STATIC=y
```

## buildroot/configs/rockchip_x11_defconfig
```kconfig
#include "base/base.config"
#include "chips/rk3588_aarch64.config"
#include "gui/x11.config"
#include "gpu/mesa3d.config"
BR2_PACKAGE_LIBGLVND=y
BR2_PACKAGE_MESA3D_OPENGL_GLX=y
```

## buildroot/package/catkin-pkg/Config.in.host
```kconfig
config BR2_PACKAGE_HOST_CATKIN_PKG
	bool "host catkin_pkg"
	depends on BR2_PACKAGE_HOST_PYTHON3
	help
	  Library for working with catkin packages.
	  This package provides tools for working with catkin packages.
	  This is a host package needed for building ROS2 packages.

	  https://github.com/ros-infrastructure/catkin_pkg
```

## buildroot/package/console-bridge/Config.in
```kconfig
config BR2_PACKAGE_CONSOLE_BRIDGE
	bool "console_bridge"
	depends on BR2_INSTALL_LIBSTDCPP
	depends on BR2_TOOLCHAIN_HAS_THREADS
	help
	  console_bridge is a ROS-independent, pure CMake package that
	  provides logging calls that mirror those found in rosconsole,
	  but for applications that are not necessarily using ROS.

	  https://github.com/ros/console_bridge
```

## buildroot/package/cpptoml/Config.in
```kconfig
config BR2_PACKAGE_CPPTOML
    bool "cpptoml"
    help
      A header-only library for parsing TOML configuration files.
      https://github.com/skystrife/cpptoml
```

## buildroot/package/libmtp/Config.in
```kconfig
config BR2_PACKAGE_LIBMTP
	bool "libmtp"
	select BR2_PACKAGE_LIBUSB
	# runtime UTF conversion support (UTF-16)
	select BR2_TOOLCHAIN_GLIBC_GCONV_LIBS_COPY if BR2_TOOLCHAIN_USES_GLIBC
	help
	  A library to access MTP (Media Transfer Protocol) Devices.

	  https://github.com/libmtp/libmtp
```

## buildroot/package/mpfr/Config.in
```kconfig
config BR2_PACKAGE_MPFR
	bool "mpfr"
	select BR2_PACKAGE_GMP
	help
	  C library for multiple-precision floating-point computations
	  with exact rounding.

	  http://www.mpfr.org/

if BR2_PACKAGE_MPFR

config BR2_PACKAGE_MPFR_STATIC
	bool "Enable static"
	default y if BR2_STATIC_LIBS

endif
```

## buildroot/package/python-empy/Config.in
```kconfig
config BR2_PACKAGE_PYTHON_EMPY
	bool "python-empy"
	help
	  Empy is a system for embedding Python expressions and statements
	  in template text; it takes an Empy source file, processes it, and
	  produces output.

	  This is accomplished via expansions, which are special signals to
	  the Empy system and are set off by a special prefix (by default
	  the at sign, '@'). Empy can expand arbitrary Python expressions
	  and statements in this way, as well as a variety of special
	  forms. Text that does not contain special forms is left
	  undisturbed.

	  https://github.com/alecthomas/empy

if BR2_PACKAGE_PYTHON_EMPY

choice
	prompt "python-empy version"
	default BR2_PACKAGE_PYTHON_EMPY_4_1

config BR2_PACKAGE_PYTHON_EMPY_4_1
	bool "python-empy v4.1"
	help
	  python-empy v4.1 for ROS2 Jazzy.

config BR2_PACKAGE_PYTHON_EMPY_3_3_4
	bool "python-empy v3.3.4"
	help
	  python-empy v3.3.4 for ROS2 Humble.

endchoice

endif
```

## buildroot/package/python-empy/Config.in.host
```kconfig
config BR2_PACKAGE_HOST_PYTHON_EMPY
	bool "host python-empy"
	help
	  Empy is a system for embedding Python expressions and statements
	  in template text; it takes an Empy source file, processes it, and
	  produces output.

	  This is accomplished via expansions, which are special signals to
	  the Empy system and are set off by a special prefix (by default
	  the at sign, '@'). Empy can expand arbitrary Python expressions
	  and statements in this way, as well as a variety of special
	  forms. Text that does not contain special forms is left
	  undisturbed.

	  https://github.com/alecthomas/empy

	  This is the host version.
```

## buildroot/package/rockchip/ipc/iva/Config.in
```kconfig
config BR2_PACKAGE_IVA
	bool "rockiva algorithm"
	help
	  rockiva library

if BR2_PACKAGE_IVA

choice
	default BR2_PACKAGE_IVA_RK3588
	prompt "target platform(32bit/64bit)"

config BR2_PACKAGE_IVA_RK3572
        bool "rockiva rk3572"
        help
          Use rockiva for rk3572.

config BR2_PACKAGE_IVA_RK3576
	bool "rockiva rk3576"
	help
	  Use rockiva for rk3576.

config BR2_PACKAGE_IVA_RK3588
	bool "rockiva rk3588"
	help
	  Use rockiva for rk3588.

config BR2_PACKAGE_IVA_RV1106
	bool "rockiva rv1106"
	help
	  Use rockiva for rv1106.

config BR2_PACKAGE_IVA_RV1126B
	bool "rockiva rv1126b"
	help
	  Use rockiva for rv1126b.
endchoice

endif
```

## buildroot/package/rockchip/ipc/rkipc/Config.in
```kconfig
config BR2_PACKAGE_RKIPC
	bool "rockchip rkipc"
	select BR2_PACKAGE_CAMERA_ENGINE_RKAIQ
	select BR2_PACKAGE_FREETYPE
	select BR2_PACKAGE_COMMON_ALGORITHM
	help
	  rockchip rkipc

choice
prompt "Platform type"
	default BR2_PACKAGE_RKIPC_RK3588
	help
	  Select a platform type.

config BR2_PACKAGE_RKIPC_RK3572
        bool "Compile for rk3572 ipc"
        select BR2_PACKAGE_ROCKIT
        select BR2_PACKAGE_ROCKCHIP_RGA
        depends on BR2_PACKAGE_RKIPC

config BR2_PACKAGE_RKIPC_RK3576
	bool "Compile for rk3576 ipc"
	select BR2_PACKAGE_ROCKIT
	select BR2_PACKAGE_ROCKCHIP_RGA
	depends on BR2_PACKAGE_RKIPC

config BR2_PACKAGE_RKIPC_RK3576_MULTI_IPC
	bool "Compile for rk3576 multi ipc"
	select BR2_PACKAGE_ROCKIT
	select BR2_PACKAGE_ROCKCHIP_RGA
	depends on BR2_PACKAGE_RKIPC

config BR2_PACKAGE_RKIPC_RK3576_DV
	bool "Compile for rk3576 dv"
	select BR2_PACKAGE_ROCKIT
	select BR2_PACKAGE_ROCKCHIP_RGA
	depends on BR2_PACKAGE_RKIPC

config BR2_PACKAGE_RKIPC_RK3588
	bool "Compile for rk3588 ipc"
	select BR2_PACKAGE_ROCKIT
	select BR2_PACKAGE_ROCKCHIP_RGA
	depends on BR2_PACKAGE_RKIPC

config BR2_PACKAGE_RKIPC_RK3588_MULTI_IPC
	bool "Compile for rk3588 multi ipc"
	select BR2_PACKAGE_ROCKIT
	select BR2_PACKAGE_ROCKCHIP_RGA
	depends on BR2_PACKAGE_RKIPC

config BR2_PACKAGE_RKIPC_RV1126
	bool "Compile for rv1126 ipc"
	select BR2_PACKAGE_RKMEDIA
	depends on BR2_PACKAGE_RKIPC

config BR2_PACKAGE_RKIPC_RV1126_BATTERY_IPC
	bool "Compile for rv1126 battery ipc"
	select BR2_PACKAGE_ROCKIT
	select BR2_PACKAGE_VENDOR_STORAGE
	depends on BR2_PACKAGE_RKIPC

config BR2_PACKAGE_RKIPC_RV1126B
	bool "Compile for rv1126b ipc"
	select BR2_PACKAGE_ROCKIT
	select BR2_PACKAGE_ROCKCHIP_RGA
	select BR2_PACKAGE_IVA
	select BR2_PACKAGE_IVA_RV1126B
	select BR2_PACKAGE_CAMERA_ENGINE_RKAIQ
	depends on BR2_PACKAGE_RKIPC

config BR2_PACKAGE_RKIPC_RV1126B_DV
	bool "Compile for rv1126b dv"
	select BR2_PACKAGE_ROCKIT
	select BR2_PACKAGE_ROCKCHIP_RGA
	select BR2_PACKAGE_IVA
	select BR2_PACKAGE_IVA_RV1126B
	select BR2_PACKAGE_CAMERA_ENGINE_RKAIQ
	depends on BR2_PACKAGE_RKIPC

endchoice

config BR2_PACKAGE_RKIPC_FASTBOOT_CUT
	bool "Fastboot cut for rkipc"
	default n
	help
	  If enabled, remove unnecessary files to save space for fastboot.
	  Enable this for fastboot optimization.
```

## buildroot/package/rockchip/rknn3-runtime/Config.in
```kconfig
config BR2_PACKAGE_RKNN3_RUNTIME
	bool "rknn3-runtime"
	help
	  RKNN3 runtime library for Rockchip NPU.

	  This package provides the RKNN3 API runtime libraries
	  for running LLM models on Rockchip NPU (RK3572 and later).

	  https://www.rock-chips.com

config BR2_PACKAGE_RKNN3_RUNTIME_ARCH
	string
	depends on BR2_ARCH = "arm" || BR2_ARCH = "aarch64"
	default "aarch64" if BR2_ARCH="aarch64"
	default BR2_ARCH
```

## buildroot/package/rockchip/rknn3-test/Config.in
```kconfig
config BR2_PACKAGE_RKNN3_TEST
	bool "rknn3-test"
	select BR2_PACKAGE_RKNPU2
	help
	  RKNN3 stress test and demo programs for Rockchip NPU.

if BR2_PACKAGE_RKNN3_TEST

config BR2_PACKAGE_RKNN3_TEST_CNN
	bool "rknn3_cnn_test"
	default y
	help
	  CNN model stress test

config BR2_PACKAGE_RKNN3_TEST_LLM
	bool "rknn3_llm_test"
	help
	  LLM model stress test

config BR2_PACKAGE_RKNN3_TEST_VLM
	bool "rknn3_vlm_test"
	help
	  VLM (Vision Language Model) stress test

config BR2_PACKAGE_RKNN3_TEST_AUDIO_ENCODER
	bool "rknn3_audio_encoder_test"
	help
	  Audio encoder stress test

config BR2_PACKAGE_RKNN3_TEST_TARGET_SOC
	string "Target SoC"
	default "rk3572"

endif
```

## buildroot/package/rockchip/rknnstream/Config.in
```kconfig
config BR2_PACKAGE_RKNNSTREAM
    bool "rknnstream"
    select BR2_PACKAGE_ROCKCHIP_OSAL
    select BR2_PACKAGE_ROCKX
```

## buildroot/package/rockchip/rockchip-ai/Config.in
```kconfig
config BR2_PACKAGE_ROCKCHIP_AI
    bool "rockchip ai"
    select BR2_PACKAGE_ROCKCHIP
    select BR2_GCC_ENABLE_OPENMP
    select BR2_PACKAGE_OPENCV4
    select BR2_PACKAGE_OPENCV4_LIB_FEATURES2D
    select BR2_PACKAGE_OPENCV4_WITH_JPEG
    # RV1126B uses rkllm backend
    select BR2_PACKAGE_RKNN_LLM if BR2_PACKAGE_RV1126B
    select BR2_PACKAGE_RKNPU2 if BR2_PACKAGE_RV1126B
    # RK3572 uses rknn3 backend
    select BR2_PACKAGE_RKNN3_RUNTIME if BR2_PACKAGE_RK3572
    help
      Rockchip AI demos (rkai) including LLM/VLM sample apps.

      Backend selection by chip:
      - RV1126B: uses rkllm (librkllmrt.so) + rknpu2
      - RK3572: uses rknn3 (librknn3_api.so)
```

## buildroot/package/rockchip/rockchip-pcba/Config.in
```kconfig
config BR2_PACKAGE_PCBA
	bool "Rockchip pcba test"
	help
	  Rockchip pcba test.

if BR2_PACKAGE_PCBA

config BR2_PACKAGE_PCBA_SCREEN
	bool "pcba with screen"
	select BR2_PACKAGE_LIBDRM
	select BR2_PACKAGE_LIBPNG
	select BR2_PACKAGE_LIBPTHREAD_STUBS
	select BR2_PACKAGE_LIBZIP
	help
	  Enable screen support for PCBA testing.
	  Note: This will automatically enable the required graphics
	  libraries (libdrm, libpng, libzip) and threading support.

endif
```

## buildroot/package/rockchip/rockchip-uvc-app/Config.in
```kconfig
config BR2_PACKAGE_ROCKCHIP_UVC_APP
	bool "rockchip uvc app"
	select BR2_PACKAGE_LIBDRM
	select BR2_PACKAGE_ROCKIT
	select BR2_PACKAGE_CAMERA_ENGINE

if BR2_PACKAGE_ROCKCHIP_UVC_APP

choice
	prompt "Build profile"
	default BR2_PACKAGE_ROCKCHIP_UVC_APP_TYPE_4K
	help
	  Select the UVC app profile.

config BR2_PACKAGE_ROCKCHIP_UVC_APP_TYPE_4K
	bool "4K"
	help
	  Build for 4K mode.

config BR2_PACKAGE_ROCKCHIP_UVC_APP_TYPE_WINHELLO
	bool "WinHello"
	help
	  Build for Windows Hello face recognition mode.

endchoice

endif
```

## buildroot/package/rockchip/rockit/Config.in
```kconfig
config BR2_PACKAGE_ROCKIT
	bool "rockit"
	select BR2_PACKAGE_ALSA_LIB
	select BR2_PACKAGE_ROCKIT_RV1126B if BR2_PACKAGE_RV1126B
	default n
	help
	  rockit

config BR2_PACKAGE_ROCKIT_RV1126B
	bool "Compile for rv1126b rockit"
	select BR2_PACKAGE_IPC_DRV_KO
	select BR2_PACKAGE_ROCKCHIP_MPP
```
