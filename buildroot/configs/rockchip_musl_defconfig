## buildroot/configs/rockchip_musl_defconfig
```kconfig
BR2_arm=y
BR2_BACKUP_SITE=""
BR2_cortex_a7=y
BR2_FORCE_HOST_BUILD=y
BR2_GNU_MIRROR="http://mirrors.kernel.org/gnu"
BR2_LINUX_KERNEL_CUSTOM_LOCAL=y
BR2_LINUX_KERNEL_CUSTOM_LOCAL_LOCATION="$(TOPDIR)/../kernel"
BR2_PACKAGE_BUSYBOX_CONFIG_FRAGMENT_FILES="board/rockchip/common/base/busybox.fragment"
BR2_PACKAGE_BUSYBOX_SHOW_OTHERS=y
BR2_PACKAGE_EXPAT=y
BR2_PACKAGE_HOST_ENVIRONMENT_SETUP=y
BR2_PACKAGE_RK3036=y
BR2_PACKAGE_ROCKCHIP=y
BR2_PRIMARY_SITE="http://sources.buildroot.net"
BR2_ROOTFS_MERGED_USR=y
BR2_ROOTFS_OVERLAY="board/rockchip/common/base board/rockchip/rk3036/fs-overlay/"
BR2_TARGET_GENERIC_HOSTNAME="rk3036"
BR2_TARGET_GENERIC_ISSUE="Welcome to RK3036 Buildroot"
BR2_TARGET_GENERIC_ROOT_PASSWD="rockchip"
BR2_TARGET_ROOTFS_EXT2=y
BR2_TARGET_ROOTFS_EXT2_4=y
BR2_TARGET_ROOTFS_EXT2_SIZE_AUTO=y
BR2_TOOLCHAIN_BUILDROOT_CXX=y
BR2_TOOLCHAIN_BUILDROOT_LOCALE=y
BR2_TOOLCHAIN_BUILDROOT_MUSL=y
```

## buildroot/configs/rockchip_rk3168_defconfig
```kconfig
BR2_arm=y
BR2_cortex_a9=y
BR2_ARM_EABI=y
BR2_ARM_FPU_NEON=y
BR2_PACKAGE_GLIBC_2_28=y
BR2_TOOLCHAIN_BUILDROOT_CXX=y
BR2_PRIMARY_SITE="https://sources.buildroot.net"
BR2_BACKUP_SITE=""
BR2_GNU_MIRROR="https://mirrors.ustc.edu.cn/gnu"
BR2_FORCE_HOST_BUILD=y
BR2_TARGET_GENERIC_HOSTNAME="rk3168"
BR2_TARGET_GENERIC_ISSUE="Welcome to RK3168 Buildroot"
BR2_ROOTFS_MERGED_USR=y
BR2_TARGET_GENERIC_ROOT_PASSWD="rockchip"
BR2_LINUX_KERNEL_CUSTOM_LOCAL=y
BR2_LINUX_KERNEL_CUSTOM_LOCAL_LOCATION="$(TOPDIR)/../kernel"
BR2_PACKAGE_BUSYBOX_SHOW_OTHERS=y
BR2_PACKAGE_STRACE=y
BR2_PACKAGE_MUPEN64PLUS=y
BR2_PACKAGE_MUPEN64PLUS_AUDIO_SDL=y
BR2_PACKAGE_MUPEN64PLUS_INPUT_SDL=y
BR2_PACKAGE_MUPEN64PLUS_RSP_HLE=y
BR2_PACKAGE_MUPEN64PLUS_VIDEO_GLIDE64MK2=y
BR2_PACKAGE_MUPEN64PLUS_VIDEO_RICE=y
BR2_PACKAGE_RETROARCH=y
BR2_PACKAGE_LIBRETRO_MUPEN64PLUS=y
BR2_PACKAGE_LIBRETRO_MUPEN64PLUS_NX=y
BR2_PACKAGE_MESA3D=y
BR2_PACKAGE_MESA3D_OSMESA_GALLIUM=y
BR2_PACKAGE_MESA3D_OPENGL_EGL=y
BR2_PACKAGE_MESA3D_OPENGL_ES=y
BR2_PACKAGE_SDL2=y
BR2_PACKAGE_SDL2_OPENGLES=y
BR2_PACKAGE_SDL2_GFX=y
BR2_PACKAGE_SDL2_IMAGE=y
BR2_PACKAGE_SDL2_TTF=y
BR2_PACKAGE_SPEEX=y
BR2_PACKAGE_LIBPNG=y
BR2_PACKAGE_PANGO=y
BR2_PACKAGE_COREUTILS=y
BR2_PACKAGE_PROCPS_NG=y
BR2_PACKAGE_PROCRANK_LINUX=y
BR2_GCC_VERSION_8_X=y
```

## buildroot/configs/rockchip_rk3326_pcba_defconfig
```kconfig
#include "base/pcba.config"
#include "chips/rk3326_aarch64.config"
#include "fs/vfat.config"
#include "fs/ntfs.config"
#include "multimedia/audio.config"
#include "multimedia/camera.config"
#include "multimedia/gst/audio.config"
#include "multimedia/gst/camera.config"
#include "multimedia/gst/video.config"
#include "multimedia/mpp.config"
#include "wifibt/bt.config"
#include "wifibt/wireless.config"

BR2_TARGET_GENERIC_HOSTNAME="rk3326_64_pcba"
```

## buildroot/configs/rockchip_rk3328_recovery_defconfig
```kconfig
#include "base/base.config"
#include "ota/recovery.config"
#include "chips/rk3328_aarch64.config"
BR2_PACKAGE_RECOVERY_NO_UI=y
```

## buildroot/configs/rockchip_rk3572_defconfig
```kconfig
#include "base/base.config"
#include "bus/can.config"
#include "bus/pci.config"
#include "chips/rk3572_aarch64.config"
#include "font/chinese.config"
#include "fs/exfat.config"
#include "fs/ntfs.config"
#include "fs/vfat.config"
#include "gpu/mali.config"
#include "multimedia/audio.config"
#include "multimedia/camera.config"
#include "multimedia/gst/audio.config"
#include "multimedia/gst/camera.config"
#include "multimedia/gst/rtsp.config"
#include "multimedia/gst/video.config"
#include "multimedia/mpp.config"
#include "wifibt/bt.config"
#include "wifibt/wireless.config"
#include "tools/benchmark.config"
#include "tools/common.config"
#include "tools/test.config"
#include "network/chromium.config"
#include "ai/npu2.config"
#include "gui/weston.config"
# BR2_PACKAGE_GST1_PLUGINS_GOOD_PLUGIN_PULSE is reset to default
BR2_PACKAGE_LIBSNDFILE=y
BR2_PACKAGE_LIBTOOL=y
# BR2_PACKAGE_PULSEAUDIO is reset to default
```

## buildroot/configs/rockchip_rk3572_ipc_defconfig
```kconfig
#include "base/base.config"
#include "chips/rk3572_aarch64.config"
#include "gpu/mali.config"
#include "multimedia/audio.config"
#include "multimedia/camera.config"
#include "multimedia/mpp.config"
#include "ai/npu2.config"
# BR2_PACKAGE_ALSA_UCM_CONF is reset to default
# BR2_PACKAGE_ALSA_UTILS is reset to default
BR2_PACKAGE_IVA=y
BR2_PACKAGE_IVA_RK3572=y
# BR2_PACKAGE_LIBMAD is reset to default
BR2_PACKAGE_NTP=y
# BR2_PACKAGE_PULSEAUDIO is reset to default
BR2_PACKAGE_RKIPC=y
BR2_PACKAGE_RKIPC_RK3572=y
BR2_PACKAGE_SAMPLES=y
BR2_PACKAGE_SAMPLES_RK3572=y
BR2_ROOTFS_OVERLAY="board/rockchip/common/base board/rockchip/rk3572/fs-overlay-ipc/"
```

## buildroot/configs/rockchip_rk3572_ramboot_defconfig
```kconfig
#include "chips/rk3572_aarch64.config"
#include "security/tee_aarch64_v2.config"
#include "base/security-ramdisk.config"

BR2_PACKAGE_TEE_USER_APP_TEE_VERSION="v3"
BR2_PACKAGE_RECOVERY=y
BR2_PACKAGE_RECOVERY_UPDATEENGINEBIN=y
```

## buildroot/configs/rockchip_rk3576_3d_cluster_defconfig
```kconfig
#include "base/base.config"
#include "bus/can.config"
#include "bus/pci.config"
#include "chips/rk3576_aarch64.config"
#include "font/chinese.config"
#include "fs/exfat.config"
#include "fs/ntfs.config"
#include "fs/vfat.config"
#include "gpu/mali.config"
#include "gui/weston.config"
#include "multimedia/audio.config"
#include "multimedia/camera.config"
#include "multimedia/gst/audio.config"
#include "multimedia/gst/camera.config"
#include "multimedia/gst/rtsp.config"
#include "multimedia/gst/video.config"
#include "multimedia/mpp.config"
#include "network/network.config"
#include "tools/benchmark.config"
#include "tools/common.config"
#include "tools/test.config"
#include "ai/npu2.config"
BR2_PACKAGE_BRIDGE_UTILS=y
BR2_PACKAGE_BUG_REPORT=y
BR2_PACKAGE_ETHTOOL=y
BR2_PACKAGE_GDB=y
BR2_PACKAGE_GDB_DEBUGGER=y
BR2_PACKAGE_HOST_GDB=y
BR2_PACKAGE_IPERF3=y
BR2_PACKAGE_RECOVERY=y
BR2_PACKAGE_RECOVERY_BOOTCONTROL=y
BR2_PACKAGE_RECOVERY_RETRY=y
BR2_PACKAGE_RECOVERY_USE_UPDATEENGINE=y
BR2_PACKAGE_ROCKCHIP_RVCAM=y
BR2_PREFER_ROCKCHIP_RGA=y
BR2_ROOTFS_OVERLAY+="board/rockchip/rk3576/fs-overlay-cluster/"
BR2_SYSTEM_BIN_SH_BUSYBOX=y
```
