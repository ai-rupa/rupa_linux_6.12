## buildroot/configs/rockchip_rk3576_gpu_pv_sec_ramboot_defconfig
```kconfig
#include "chips/rk3576_aarch64.config"
#include "base/security-ramdisk.config"
#include "tee_aarch64_v2.config"
BR2_ROOTFS_OVERLAY+="../external/gpu_pv_ko/for_buildroot/fs-overlay-gpu-pv"
BR2_PACKAGE_BUSYBOX_CONFIG_FRAGMENT_FILES="../external/gpu_pv_ko/for_buildroot/fs-overlay-gpu-pv/busybox.fragment"

BR2_PACKAGE_RECOVERY=y
BR2_PACKAGE_RECOVERY_UPDATEENGINEBIN=y
```

## buildroot/configs/rockchip_rv1126b_32_ipc_defconfig
```kconfig
#include "base/base.config"
#include "wifibt/bt.config"
#include "wifibt/wireless.config"
#include "chips/rv1126b_arm.config"
#include "multimedia/mpp.config"
#include "multimedia/audio.config"
#include "multimedia/camera.config"
# BR2_PACKAGE_ALSA_UCM_CONF is reset to default
# BR2_PACKAGE_ALSA_UTILS is reset to default
BR2_PACKAGE_COMMON_ALGORITHM=y
BR2_PACKAGE_IPCWEB_BACKEND=y
BR2_PACKAGE_IPCWEB_BACKEND_USE_RKIPC=y
BR2_PACKAGE_IVA=y
BR2_PACKAGE_IVA_RV1126B=y
# BR2_PACKAGE_LIBMAD is reset to default
BR2_PACKAGE_LIBSNDFILE=y
BR2_PACKAGE_LIBTOOL=y
BR2_PACKAGE_LIBXCRYPT=y
BR2_PACKAGE_NGINX=y
BR2_PACKAGE_NGINX_HTTP_FLV_LIVE=y
BR2_PACKAGE_NGINX_HTTP_GZIP_STATIC_MODULE=y
BR2_PACKAGE_NTP=y
BR2_PACKAGE_PCRE=y
# BR2_PACKAGE_PULSEAUDIO is reset to default
BR2_PACKAGE_RKFSMK=y
BR2_PACKAGE_RKIPC=y
BR2_PACKAGE_RKIPC_RV1126B=y
BR2_PACKAGE_ROCKCHIP_TEST=y
BR2_PACKAGE_SAMPLES=y
BR2_PACKAGE_SAMPLES_RV1126B=y
BR2_ROOTFS_OVERLAY="board/rockchip/common/base board/rockchip/rv1126b/fs-overlay-ipc/"
```

## buildroot/configs/rockchip_rv1126b_ramboot_defconfig
```kconfig
#include "chips/rv1126b_aarch64.config"
#include "base/kernel.config"
#include "security/tee_aarch64_v2.config"
BR2_TARGET_ROOTFS_CPIO=y
BR2_TARGET_ROOTFS_CPIO_GZIP=y
BR2_PACKAGE_LUKSMETA=y
BR2_ROOTFS_OVERLAY+="board/rockchip/common/security-ramdisk-overlay/"
BR2_PACKAGE_RECOVERY=y
BR2_PACKAGE_ROCKCHIP=y
BR2_PACKAGE_RECOVERY_UPDATEENGINEBIN=y
```

## buildroot/package/mupen64plus/mupen64plus-video-gles2rice/Config.in
```kconfig
config BR2_PACKAGE_MUPEN64PLUS_VIDEO_GLES2RICE
	bool "mupen64plus-video-gles2rice"
	depends on BR2_PACKAGE_MUPEN64PLUS_CORE
	depends on BR2_PACKAGE_LIBPNG
	depends on BR2_PACKAGE_SDL2
	depends on !BR2_PACKAGE_MUPEN64PLUS_VIDEO_RICE
	help
	  mupen64plus video gles2rice.

	  https://mupen64plus.org/
```

## buildroot/package/ppsspp/Config.in
```kconfig
config BR2_PACKAGE_PPSSPP
	bool "ppsspp"
	depends on BR2_INSTALL_LIBSTDCPP
	select BR2_PACKAGE_SDL2
	select BR2_PACKAGE_SDL2_TTF
	select BR2_PACKAGE_FONTCONFIG
	select BR2_PACKAGE_ZLIB
	select BR2_PACKAGE_ZSTD
	select BR2_PACKAGE_LIBPNG
	select BR2_PACKAGE_LIBZIP
	help
	  PPSSPP - a fast and portable PSP emulator.

	  https://www.ppsspp.org/

comment "PPSSPP needs a toolchain w/ C++"
	depends on !BR2_INSTALL_LIBSTDCPP
```

## buildroot/package/rockchip/bug-report/Config.in
```kconfig
config BR2_PACKAGE_BUG_REPORT
	bool "rockchip bug-report"

if BR2_PACKAGE_BUG_REPORT

config BR2_PACKAGE_BUG_REPORT_STATIC
	bool "Enable static"
	default y if BR2_STATIC_LIBS

endif
```

## buildroot/package/rockchip/rknn-llm/Config.in
```kconfig
config BR2_PACKAGE_RKNN_LLM
	bool "rknn-llm"
	help
	  "rknn-llm runtime lib and server"

config BR2_PACKAGE_RKNN_LLM_ARCH
	string
	depends on BR2_ARCH = "arm" || BR2_ARCH = "aarch64"
	default "aarch64" if BR2_ARCH="aarch64"
	default BR2_ARCH
```

## buildroot/package/rockchip/rkscript/Config.in
```kconfig
config BR2_PACKAGE_RKSCRIPT
	bool "rockchip script"
	help
	  Rockchip helper scripts.

if BR2_PACKAGE_RKSCRIPT

config BR2_PACKAGE_RKSCRIPT_DEFAULT_PCM
	string "default PCM"
	help
	  Alsa's default PCM

config BR2_PACKAGE_RKSCRIPT_IODOMAIN_NOTICE
	bool "rkscript iodomain notice script"
	default y if BR2_PACKAGE_RK3308
	default y if BR2_PACKAGE_RV1126_RV1109
	default y if BR2_PACKAGE_RK3566_RK3568
	select BR2_PACKAGE_RKTOOLKIT
	help
	  Install iodomain notice script.

endif
```

## buildroot/package/rockchip/wayland-cluster/Config.in
```kconfig
config BR2_PACKAGE_WAYLAND_CLUSTER
	bool "wayland-cluster"
	select BR2_PACKAGE_STB
	select BR2_PACKAGE_CAIRO
	select BR2_PACKAGE_FONTCONFIG
	select BR2_PACKAGE_ROCKCHIP_RGA
	depends on BR2_PACKAGE_HAS_LIBEGL
	depends on BR2_PACKAGE_WAYLAND
	select BR2_PACKAGE_WAYLAND_PROTOCOLS if BR2_PACKAGE_WAYLAND
	help
	  Cluster Demo application based on wayland

config BR2_PACKAGE_CLUSTER_ERPC
	bool "wayland-cluster-with-erpc"
	select BR2_PACKAGE_ROCKCHIP_ERPC
	help
		Cluster Demo application with erpc can show erpc client image.
```

## device/rockchip/.chips/rk3588/amp_mcu.its
```
/* SPDX-License-Identifier: BSD-3-Clause */
/*
 * Copyright (c) 2023 Rockchip Electronics Co., Ltd.
 */

/dts-v1/;
/ {
	description = "FIT source file for rockchip AMP";
	#address-cells = <1>;

	images {
		mcu {
			description  = "mcu";
			data         = /incbin/("rtt.bin");
			type         = "standalone";
			compression  = "none";
			arch         = "arm";
			udelay       = <10000>;
			load         = <0x07a00000>;
			sram_start   = <0x00000000>;    // {pmu1_sgrf_soc_con10[15:0],16'h0}
			dev_start    = <0xF0000000>;
			exsram_start = <0x00000000>;    // {pmu1_sgrf_soc_con11[15:0],16'h0}
			experi_start = <0x00000000>;    // {pmu1_sgrf_soc_con12[15:0],16'h0}
			uc_start     = <0x07C00000>;    // {pmu1_sgrf_soc_con8[3:0],pmu1_sgrf_soc_con6[15:0],12'h0}
			uc_end       = <0xFEE00000>;    // {pmu1_sgrf_soc_con8[7:4],pmu1_sgrf_soc_con7[15:0],12'h0}

			cpu          = <0>;
			compile {
				size         = <0x00200000>;
				sys          = "rtt";    // "hal" or "rtt"
				rtt_config   = "board/evb/defconfig"
				core         = "mcu";    // "mcu" or "ap"
				rtt_exec     = "prebuilts/gcc/linux-x86/arm/gcc-arm-none-eabi-10-2020-q4-major-x86_64-linux/bin/"
				cc           = "prebuilts/gcc/linux-x86/arm/gcc-arm-none-eabi-10-2020-q4-major-x86_64-linux/bin/arm-none-eabi-"
			};

			hash {
				algo = "sha256";
			};
		};
	};

	share {
		rpmsg_base      = <0x07c00000>;
		rpmsg_size      = <0x00600000>;
	};

	configurations {
		default = "conf";
		conf {
			description = "Rockchip AMP images";
			rollback-index = <0x0>;
			loadables = "mcu";

			signature {
				algo = "sha256,rsa2048";
				padding = "pss";
				key-name-hint = "dev";
				sign-images = "loadables";
			};

			/* - run linux on cpu0
			 * - it is brought up by amp(that run on U-Boot)
			 * - it is boot entry depends on U-Boot
			 */
			linux {
				description  = "linux-os";
				arch         = "arm64";
				cpu          = <0x000>;
				thumb        = <0>;
				hyp          = <0>;
				udelay       = <0>;
				load         = <0x02000000>;
				load_c       = <0x05480000>;
			};
		};
	};
};
```

## device/rockchip/.chips/rv1126b/fastboot-boot.its
```
/*
 * Copyright (C) 2022 Rockchip Electronics Co., Ltd
 *
 * SPDX-License-Identifier: GPL-2.0
 */

/dts-v1/;
/ {
	description = "FIT source file for Linux";
	#address-cells = <1>;

	images {
		fdt {
			data = /incbin/("@KERNEL_DTB@");
			type = "flat_dt";
			arch = "arm64";
			compression = "none";
			load  = <0x47fbf000>;
			hash {
				algo = "sha256";
				uboot-ignore = <0>;
			};
		};

		kernel {
			data = /incbin/("@KERNEL_IMG@");
			compression = "gzip";
			type = "kernel";
			arch = "arm64";
			os = "linux";
			comp = <@KERNEL_C@>;
			entry = <0x40200000>;
			load  = <0x40200000>;
			hash {
				algo = "sha256";
				uboot-ignore = <0>;
			};
		};
	};

	configurations {
		default = "conf";
		conf {
			description = "Boot Linux kernel with FDT blob and no ramdisk";
			rollback-index = <0x0>;
			fdt = "fdt";
			kernel = "kernel";
			signature {
				algo = "sha256,rsa2048";
				padding = "pss";
				key-name-hint = "dev";
				sign-images = "fdt", "kernel";
			};
		};
	};
};
```

## device/rockchip/.chips/rv1126b/fastboot-rootfs.its
```
/*
 * Copyright (C) 2025 Rockchip Electronics Co., Ltd
 *
 * SPDX-License-Identifier: GPL-2.0
 */

/dts-v1/;
/ {
	description = "FIT source file for Linux";
	#address-cells = <1>;

	images {
		ramdisk {
			data = /incbin/("@RAMDISK_IMG@");
			compression = "gzip";
			type = "ramdisk";
			arch = "arm";
			os = "linux";
			preload = <1>;
			comp = <@RAMDISK_C@>;
			load  = <@RAMDISK_R@>;
			decomp-async;
			hash {
				algo = "sha256";
				uboot-ignore = <1>;
			};
		};
	};

	configurations {
		default = "conf";
		conf {
			description = "Fit ramdisk";
			rollback-index = <0x0>;
			ramdisk = "ramdisk";
			signature {
				algo = "sha256,rsa2048";
				padding = "pss";
				key-name-hint = "dev";
				sign-images = "ramdisk";
			};
		};
	};
};
```

## yocto/layers/meta-yocto/meta-poky/conf/distro/include/poky-distro-alt-test-config.inc
```bitbake
# Add extra DISTRO_FEATUREs
DISTRO_FEATURES:append = " pam usrmerge"

# Use our alternate kernel version
PREFERRED_VERSION_linux-yocto = "6.18%"

# Ensure the kernel nfs server is enabled
KERNEL_FEATURES:append:pn-linux-yocto = " features/nfsd/nfsd-enable.scc"
KERNEL_FEATURES:append:pn-linux-yocto-dev = " features/nfsd/nfsd-enable.scc"
```
