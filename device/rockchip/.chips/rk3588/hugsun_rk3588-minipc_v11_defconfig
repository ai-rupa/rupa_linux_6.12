## device/rockchip/.chips/rv1126b/amp_mcu.its
```
/* SPDX-License-Identifier: BSD-3-Clause */
/*
 * Copyright (c) 2023 Rockchip Electronics Co., Ltd.
 */

/dts-v1/;
/ {
	description = "FIT source file for rockchip AMP";
	#address-cells = <1>;

	images {
		hpmcu {
			description  = "hpmcu";
			data         = /incbin/("rtt.bin");
			type         = "standalone";
			compression  = "none";
			arch         = "arm"; //Actually it's riscv, but uboot only accept arm/arm64
			udelay       = <10000>;
			load         = <0x48c22000>;
			compile {
				size         = <0x0003a000>;
				sys          = "rtt";    // "hal" or "rtt"
				rtt_config   = "board/rv1126b_evb1/defconfig"
				core         = "mcu";    // "mcu" or "ap"
				rtt_exec     = "prebuilts/gcc/linux-x86/riscv/xpack-riscv-none-embed-gcc-10.2.0-1.2/bin/"
				cc           = "prebuilts/gcc/linux-x86/riscv/xpack-riscv-none-embed-gcc-10.2.0-1.2/bin/riscv-none-embed-"
			};

			hash {
				algo = "sha256";
			};
		};
	};

	share {
		rpmsg_base      = <0x48c02000>;
		rpmsg_size      = <0x00020000>;
	};

	configurations {
		default = "conf";
		conf {
			description = "Rockchip AMP images";
			rollback-index = <0x0>;
			loadables = "hpmcu";

			signature {
				algo = "sha256,rsa2048";
				padding = "pss";
				key-name-hint = "dev";
				sign-images = "loadables";
			};
		};
	};
};
```

## external/rkwifibt/drivers/swt6621s-new/Kconfig
```kconfig
source "drivers/net/wireless/rockchip_wlan/swt6621s/swtbt4l/Kconfig"
source "drivers/net/wireless/rockchip_wlan/swt6621s/swt6621s_wifi/Kconfig"
source "drivers/net/wireless/rockchip_wlan/swt6621s/seekwaveplatform_lite/Kconfig"
```
