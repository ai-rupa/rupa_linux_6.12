// SPDX-License-Identifier: (GPL-2.0+ OR MIT)
/*
 * Copyright (c) 2025 Rockchip Electronics Co., Ltd.
 */

/dts-v1/;

#include "rk3572-hugsun-nas-v10.dtsi"
#include "rk3572-linux.dtsi"

/ {
	model = "Hugsun RK3572 NAS V10 Board";
	compatible = "rockchip,rk3572-hugsun-nas-v10", "rockchip,rk3572";
};
